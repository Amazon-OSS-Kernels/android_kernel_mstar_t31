## kernel/mstar/t31/4.9/drivers/ffdspctrl/Kconfig
```kconfig
#
# Input core configuration
#
config FFDSPCTRL
	boolean "Farfeild DSP power control"
	default n
	help
	  Say Y here if you want to control farfeild dsp power in kernel.
```

## kernel/mstar/t31/4.9/drivers/misc/presence/Kconfig
```kconfig
config SENSORS_SC1233A
        tristate "SOCIONEXT SC1233A motion_sensor"
        depends on I2C && SYSFS
        default n
        help
          Say Y here if you want to build a driver for Socionext SC1233A.
```

## kernel/mstar/t31/4.9/drivers/mstar2/drv/hifi4dsp/Kconfig
```kconfig
#
# MediaTek HIFI4DSP SPI and Load Driver
#

config MTK_HIFI4DSP_SUPPORT
	bool "Support Mediatek HIFI4DSP"
	---help---
	  Say yes here to build support for Mediatek HIFI4DSP.
	  It includes spi driver, load driver, ipi driver,
	  wdt driver, i2c driver and so on.
	  If unsure, say N.

config MTK_HIFI4DSP_CHECK_DSP_DVFS
	bool "Mediatek HIFI4DSP SPI check DSP CLK Status"
	depends on MTK_HIFI4DSP_SUPPORT
	---help---
	  Say yes here to enable DSP DVFS check mechanism.
	  It depends on MTK_HIFI4DSP_SUPPORT.
	  If unsure, say N.

config MTK_HIFI4DSP_WDT_RECOVER_SUPPORT
	bool "Mediatek HIFI4DSP WDT Recovery Support"
	depends on MTK_HIFI4DSP_SUPPORT
	---help---
	  Say yes here to enable DSP WDT recovery.
	  It depends on MTK_HIFI4DSP_SUPPORT.
	  If unsure, say N.
```

## kernel/mstar/t31/4.9/drivers/mstar2/drv/tool_daemon_xc_action/Kconfig
```kconfig
config MSTAR_TOOL_DAEMON_XC_ACTION
tristate "Tool Daemon XC Action Handler"
help
    XC Action Handler for MStar Tool Daemon
```

## kernel/mstar/t31/4.9/drivers/staging/amazon/Kconfig
```kconfig
menu "Amazon"

config AMAZON
	bool "Amazon Drivers"

	default n
	---help---
	  Enable support for various drivers needed on the Amazon Fire OS platform

if AMAZON

config AMAZON_SIGN_OF_LIFE
	bool "Amazon Sign of Life"
	default n
	---help---
          Use to log device boot and shutdown metrics.
          This is a generic driver, the platform part is implemented
          to do the real work.

config AMAZON_SIGN_OF_LIFE_MSTAR
	bool "Amazon Sign of Life MStar platform implementation"
	depends on AMAZON_SIGN_OF_LIFE
	default n
	---help---
	  The life cycle is implemented on MStar platform to record
	  boot/shutdown information.


config AMAZON_METRICS_LOG
	bool "Amazon Metrics logger driver"
	select RING_BUFFER
	default n
	---help---
	  Enable Amazon Metrics/Vitals logger driver

config AMAZON_MINERVA_METRICS_LOG
	bool "Amazon Minerva Metrics logger"
	select RING_BUFFER
	default n
	---help---
	  Enable Amazon Minerva logger

config AMAZON_METRICS_LOG_TEST
	tristate "Amazon Metrics logger driver test module"
	depends on AMAZON_METRICS_LOG
	default n
	---help---
	  Enable Amazon Metrics/Vitals logger test module

config AMAZON_SILENT_OTA_BACKLIGHT
	bool "Amazon silent ota backlight control"
	default n
	---help---
	  Enable Amazon silent ota backlight control

config AMAZON_HID_BATTERY_NOTIFICATION
	bool "HID Battery Notification"
	default n

config MP_MSTAR_POWER
	tristate "MStar Power"
	help
	  Implement kernel power driver for MSTAR T22.

config AMZ_MISC
	bool "Amazon cutomization"
	default n

config MP_RTC_WAKEUP_DEBUG
	bool "Amazon cutomization"
	default n

endif # if AMAZON

source "drivers/staging/amazon/dspframework/Kconfig"

endmenu
```

## kernel/mstar/t31/4.9/sound/soc/mediatek/Kconfig
```kconfig
config SND_SOC_MEDIATEK
	tristate

config SND_SOC_MT2701
	tristate "ASoC support for Mediatek MT2701 chip"
	depends on ARCH_MEDIATEK
	select SND_SOC_MEDIATEK
	help
	  This adds ASoC driver for Mediatek MT2701 boards
	  that can be used with other codecs.
	  Select Y if you have such device.
	  If unsure select "N".

config SND_SOC_MT2701_CS42448
	tristate "ASoc Audio driver for MT2701 with CS42448 codec"
	depends on SND_SOC_MT2701 && I2C
	select SND_SOC_CS42XX8_I2C
	select SND_SOC_BT_SCO
	help
	  This adds ASoC driver for Mediatek MT2701 boards
	  with the CS42448 codecs.
	  Select Y if you have such device.
	  If unsure select "N".

config SND_SOC_MT8173
	tristate "ASoC support for Mediatek MT8173 chip"
	depends on ARCH_MEDIATEK
	select SND_SOC_MEDIATEK
	help
	  This adds ASoC platform driver support for Mediatek MT8173 chip
	  that can be used with other codecs.
	  Select Y if you have such device.
	  Ex: MT8173

config SND_SOC_MT8173_MAX98090
	tristate "ASoC Audio driver for MT8173 with MAX98090 codec"
	depends on SND_SOC_MT8173 && I2C
	select SND_SOC_MAX98090
	help
	  This adds ASoC driver for Mediatek MT8173 boards
	  with the MAX98090 audio codec.
	  Select Y if you have such device.
	  If unsure select "N".

config SND_SOC_MT8173_RT5650
	tristate "ASoC Audio driver for MT8173 with RT5650 codec"
	depends on SND_SOC_MT8173 && I2C
	select SND_SOC_RT5645
	select SND_SOC_HDMI_CODEC
	help
	  This adds ASoC driver for Mediatek MT8173 boards
	  with the RT5650 audio codec.
	  Select Y if you have such device.
	  If unsure select "N".

config SND_SOC_MT8173_RT5650_RT5514
	tristate "ASoC Audio driver for MT8173 with RT5650 RT5514 codecs"
	depends on SND_SOC_MT8173 && I2C
	select SND_SOC_RT5645
	select SND_SOC_RT5514
	help
	  This adds ASoC driver for Mediatek MT8173 boards
	  with the RT5650 and RT5514 codecs.
	  Select Y if you have such device.
	  If unsure select "N".

config SND_SOC_MT8173_RT5650_RT5676
	tristate "ASoC Audio driver for MT8173 with RT5650 RT5676 codecs"
	depends on SND_SOC_MT8173 && I2C
	select SND_SOC_RT5645
	select SND_SOC_RT5677
	select SND_SOC_HDMI_CODEC
	help
	  This adds ASoC driver for Mediatek MT8173 boards
	  with the RT5650 and RT5676 codecs.
	  Select Y if you have such device.
	  If unsure select "N".

config SND_SOC_MT8518
	tristate "ASoC support for Mediatek MT8518 chip"
	select SND_SOC_MEDIATEK
	help
	  This adds ASoC platform driver support for Mediatek MT8518 chip
	  that can be used with other codecs.
	  Select Y if you have such device.
	  Ex: MT8158

config SND_SOC_MT8518_ADSP_VOICE_ASSIST
	tristate "ADSP voice assist support for Mediatek MT8518 chip"
	depends on MTK_HIFI4DSP_SUPPORT
	help
	  This adds ADSP voice asssit driver support for Mediatek MT8518 chip.
	  Only enable this when we have DSP.
	  Select Y if you need the pcm playback feature.
	  If unsure select "N".

config SND_SOC_MT8570_ADSP_XAF_2ND_CAPTURE
	tristate "ADSP XAF 2nd capture support for Mediatek MT8570 chip"
	depends on MTK_HIFI4DSP_SUPPORT
	help
	  This adds ADSP XAF 2nd capture driver support for Mediatek MT8570 chip.
	  Only enable this when we have DSP.
	  Select Y if you need the dsp feature.
	  If unsure select "N".

config SND_SOC_MT8518_EVB
	tristate "ASoC Audio driver for MT8158 with internal codec"
	depends on SND_SOC_MT8518
	select SND_SOC_MT8518_CODEC
	help
	  This adds ASoC driver for Mediatek MT8518 boards
	  with the internal audio codec.
	  Select Y if you have such device.
	  If unsure select "N".
```
