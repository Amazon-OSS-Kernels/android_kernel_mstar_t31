/dts-v1/;
/plugin/;

/ {
        fragment@0 {
               target = <&soc_m5621>;
               __overlay__ {
                      android {
                          serialno ="001122333";
                          fstab {
                                    compatible = "android,fstab";
                                    vendor {
                                        compatible = "android,vendor";
                                        dev = "/dev/block/platform/mstar_mci.0/by-name/vendor";
                                        type = "ext4";
                                        mnt_flags = "ro";
                                        fsmgr_flags = "wait";
                                    };

                                };
                      };
               };
        };
};
